## conf/layer.conf
```bitbake
# We have a conf and classes directory, add to BBPATH
BBPATH .= ":${LAYERDIR}"

# We have a recipes-* directories, add to BBFILES
BBFILES += "${LAYERDIR}/recipes-*/*/*.bb \
	${LAYERDIR}/recipes-*/*/*.bbappend"

BBFILE_COLLECTIONS += "pine64-layer"
BBFILE_PATTERN_pine64-layer = "^${LAYERDIR}/"
BBFILE_PRIORITY_pine64-layer = "5"

LAYERSERIES_COMPAT_pine64-layer = "honister kirkstone"

# This should only be incremented on significant changes that will
# cause compatibility issues with other layers
LAYERVERSION_pine64-layer = "1"

# meta-arm for trusted-firmware-a_%.bb
LAYERDEPENDS_pine64-layer = "core meta-arm"
```

## conf/machine/include/a64.inc
```bitbake
SOC_FAMILY = "a64"

require conf/machine/include/soc-family.inc

PREFERRED_PROVIDER_virtual/bootloader ?= "u-boot"
UBOOT_BINARY ?= "u-boot-sunxi-with-spl.bin"
SPL_BINARY ?= "spl/sunxi-spl.bin"
UBOOT_ENTRYPOINT = "0x40080000"
UBOOT_DTB_LOADADDRESS = "0x4FA00000"
UBOOT_ENV ?= "boot"
UBOOT_ENV_SUFFIX ?= "scr"
```

## conf/machine/include/h6.inc
```bitbake
SOC_FAMILY = "h6"

require conf/machine/include/soc-family.inc

PREFERRED_PROVIDER_virtual/bootloader ?= "u-boot"
SPL_BINARY ?= "u-boot-sunxi-with-spl.bin"
UBOOT_ENTRYPOINT = "0x4fd00000"

TFA_PLATFORM = "sun50i_h6"
TFA_BUILD_TARGET = "bl31"
```

## conf/machine/include/radxa-rock5b.inc
```bitbake
require conf/machine/include/arm/arch-arm64.inc
require conf/machine/include/rk3588.inc

EXTRA_IMAGEDEPENDS += "u-boot"
UBOOT_MACHINE ?= "rock5b-rk3588_defconfig"

PREFERRED_PROVIDER_virtual/kernel ?= "linux-yocto"
KCONFIG_MODE ?= "alldefconfig"
KBUILD_DEFCONFIG ?= "defconfig"
LINUX_VERSION_EXTENSION ?= "-rock5b"

KERNEL_IMAGETYPE = "Image"
KERNEL_DEVICETREE = " \
    rockchip/rk3588-rock-5b.dtb \
    rockchip/rk3588-rock-5b-pcie-ep.dtbo \
    rockchip/rk3588-rock-5b-pcie-srns.dtbo \
    "

MACHINE_EXTRA_RRECOMMENDS += "kernel-modules"

UBOOT_EXTLINUX = "1"
UBOOT_EXTLINUX_CONSOLE = "console=ttyS2,1500000"
UBOOT_EXTLINUX_ROOT = "root=/dev/mmcblk1p2"
UBOOT_EXTLINUX_FDT = "../rk3588-rock-5b.dtb"

IMAGE_FSTYPES += "wic"
WKS_FILE ?= "radxa-rock5b-bsp-image.wks"

WKS_FILE_DEPENDS ?= " \
    e2fsprogs-native \
    mtools-native \
    dosfstools-native \
    virtual/bootloader \
    virtual/kernel \
    "

SERIAL_CONSOLES = "1500000;ttyS2"
MACHINE_FEATURES = "alsa apm keyboard rtc serial usbgadget usbhost vfat ext2 ext3 wifi"
```

## conf/machine/include/rk3399.inc
```bitbake
SOC_FAMILY = "rk3399"

require conf/machine/include/soc-family.inc

PREFERRED_PROVIDER_virtual/bootloader ?= "u-boot"
UBOOT_BINARY ?= "u-boot.itb"
SPL_BINARY ?= "idbloader.img"

TFA_PLATFORM = "rk3399"
TFA_BUILD_TARGET = "bl31"
```

## conf/machine/include/rk3566.inc
```bitbake
SOC_FAMILY = "rk3566"

require conf/machine/include/soc-family.inc

PREFERRED_PROVIDER_virtual/bootloader ?= "u-boot"
UBOOT_BINARY ?= "u-boot-rockchip.bin"
SPL_BINARY ?= ""

TFA_PLATFORM = "rk3566"
TFA_BUILD_TARGET = "bl31"
```

## conf/machine/include/rk3588.inc
```bitbake
SOC_FAMILY = "rk3588"

require conf/machine/include/soc-family.inc

PREFERRED_PROVIDER_virtual/bootloader ?= "u-boot"
UBOOT_BINARY ?= "u-boot.itb"
SPL_BINARY ?= "idbloader.img"

TFA_PLATFORM = "rk3588"
TFA_BUILD_TARGET = "bl31"
```

## conf/machine/pine-a64-lts.conf
```bitbake
#@TYPE: Machine
#@NAME: Pine A64 LTS Board
#@DESCRIPTION: An Allwinner based development board https://www.pine64.org/

require conf/machine/include/arm/arch-arm64.inc

PREFERRED_PROVIDER_virtual/bootloader ?= "u-boot"
EXTRA_IMAGEDEPENDS += "u-boot"
UBOOT_MACHINE ?= "pine64-lts_defconfig"
UBOOT_BINARY ?= "u-boot-sunxi-with-spl.bin"
UBOOT_ENV ?= "boot"
UBOOT_ENV_SUFFIX ?= "scr"
SPL_BINARY ?= "spl/sunxi-spl.bin"
UBOOT_ENTRYPOINT = "0x40080000"
UBOOT_DTB_LOADADDRESS = "0x4FA00000"

PREFERRED_PROVIDER_virtual/kernel ?= "linux-pine64"
KERNEL_CLASSES = "kernel-fitimage"
KERNEL_IMAGETYPE = "fitImage"
KERNEL_DEVICETREE = "allwinner/sun50i-a64-pine64-lts.dtb"

MACHINE_EXTRA_RRECOMMENDS += "kernel-modules"

IMAGE_FSTYPES += "wic"
WKS_FILE ?= "pine64-bsp-image.wks"

IMAGE_BOOT_FILES ?= " \
    fitImage \
    boot.scr \
    "

WKS_FILE_DEPENDS ?= " \
    mtools-native \
    dosfstools-native \
    virtual/bootloader \
    virtual/kernel \
    "

SERIAL_CONSOLES = "115200;ttyS0"
MACHINE_FEATURES = "alsa apm keyboard rtc serial screen touchscreen usbgadget usbhost vfat ext2 ext3 wifi"
```

## conf/machine/pine-h64-model-b.conf
```bitbake
require conf/machine/pine-h64.conf

# kernel
KERNEL_DEVICETREE = "allwinner/sun50i-h6-pine-h64-model-b.dtb"
```

## conf/machine/pine-h64.conf
```bitbake
require conf/machine/include/arm/arch-armv8a.inc
require conf/machine/include/h6.inc

# kernel
PREFERRED_PROVIDER_virtual/kernel ?= "linux-yocto"
KCONFIG_MODE ?= "alldefconfig"
KBUILD_DEFCONFIG ?= "defconfig"
LINUX_VERSION_EXTENSION ?= "-allwinner"

KERNEL_DEVICETREE = "allwinner/sun50i-h6-pine-h64.dtb"
KERNEL_CLASSES = "kernel-fitimage"
KERNEL_IMAGETYPE = "fitImage"

# u-boot configuration
UBOOT_CONFIG ??= "sd"
UBOOT_CONFIG[sd] = "pine_h64_defconfig"

WKS_FILES = "h6-bsp-image.wks"

WKS_FILE_DEPENDS ?= " \
    mtools-native \
    dosfstools-native \
    virtual/bootloader \
    virtual/kernel \
    "

IMAGE_BOOT_FILES ?= "\
    ${KERNEL_IMAGETYPE} \
    "

# Set Serial console
SERIAL_CONSOLE = "115200;ttyS0"

MACHINE_EXTRA_RRECOMMENDS += "kernel-modules"
```

## conf/machine/pine-pinetab2.conf
```bitbake
#@TYPE: Machine
#@NAME: Pine PineTab2
#@DESCRIPTION: An Rockchip RK356x based linux tablet https://www.pine64.org/

require conf/machine/include/arm/arch-arm64.inc
require conf/machine/include/rk3566.inc

EXTRA_IMAGEDEPENDS += "u-boot"
UBOOT_MACHINE ?= "pinetab2-rk3566_defconfig"

PREFERRED_PROVIDER_virtual/kernel ?= "linux-pinetab2-danctnix"
KCONFIG_MODE ?= "alldefconfig"
KBUILD_DEFCONFIG ?= "defconfig"
LINUX_VERSION_EXTENSION ?= "-pinetab2"

KERNEL_IMAGETYPE = "Image"
KERNEL_DEVICETREE = "rockchip/rk3566-pinetab2-v2.0.dtb"

MACHINE_EXTRA_RRECOMMENDS += "kernel-modules"

UBOOT_EXTLINUX = "1"
UBOOT_EXTLINUX_CONSOLE = "console=ttyS2,1500000"
UBOOT_EXTLINUX_ROOT = "root=/dev/mmcblk1p2"
UBOOT_EXTLINUX_FDT = "../rk3566-pinetab2-v2.0.dtb"

IMAGE_FSTYPES += "wic"
WKS_FILE ?= "pine-pinetab2-bsp-image.wks"

IMAGE_BOOT_FILES ?= " \
    Image \
    rk3566-pinetab2-v2.0.dtb \
    extlinux.conf;extlinux/extlinux.conf \
    "

WKS_FILE_DEPENDS ?= " \
    e2fsprogs-native \
    mtools-native \
    dosfstools-native \
    virtual/bootloader \
    virtual/kernel \
    "

SERIAL_CONSOLES = "1500000;ttyS2"
MACHINE_FEATURES = "alsa apm keyboard rtc serial screen touchscreen usbhost vfat ext2 ext3 wifi"
MACHINE_EXTRA_RDEPENDS += "bes2600-firmware"
```

## conf/machine/pine-rockpro64.conf
```bitbake
#@TYPE: Machine
#@NAME: Pine RockPro64
#@DESCRIPTION: An Rockchip RK3399 based development board https://www.pine64.org/

require conf/machine/include/arm/arch-arm64.inc
require conf/machine/include/rk3399.inc

EXTRA_IMAGEDEPENDS += "u-boot"
UBOOT_MACHINE ?= "rockpro64-rk3399_defconfig"

PREFERRED_PROVIDER_virtual/kernel ?= '${@bb.utils.contains("DISTRO_FEATURES", "pci_ep", "linux-rockpro64-ep", "linux-yocto", d)}'

KERNEL_IMAGETYPE = "Image"
KERNEL_DEVICETREE = "rockchip/rk3399-rockpro64.dtb"

MACHINE_EXTRA_RRECOMMENDS += "kernel-modules"

MACHINE_EXTRA_RRECOMMENDS += '${@bb.utils.contains("DISTRO_FEATURES", "pci_ep", " pci-ep-scripts", "", d)}'

UBOOT_EXTLINUX = "1"
UBOOT_EXTLINUX_CONSOLE = "console=ttyS2,1500000"
UBOOT_EXTLINUX_ROOT = "root=/dev/mmcblk1p2"
UBOOT_EXTLINUX_FDT = "rk3399-rockpro64.dtb"

IMAGE_FSTYPES += "wic"
WKS_FILE ?= "pine-rockpro64-bsp-image.wks"

IMAGE_BOOT_FILES ?= " \
    Image \
    rk3399-rockpro64.dtb \
    extlinux.conf;extlinux/extlinux.conf \
    "

WKS_FILE_DEPENDS ?= " \
    e2fsprogs-native \
    mtools-native \
    dosfstools-native \
    virtual/bootloader \
    virtual/kernel \
    "

SERIAL_CONSOLES = "1500000;ttyS2"
MACHINE_FEATURES = "alsa apm keyboard rtc serial usbgadget usbhost vfat ext2 ext3 wifi"
```

## conf/machine/pinenote-a55.conf
```bitbake
#@TYPE: Machine
#@NAME: PineNote A55 Board
#@DESCRIPTION: An Allwinner based E-ink tablet https://www.pine64.org/PineNote/

require conf/machine/include/arm/arch-arm64.inc

PREFERRED_PROVIDER_virtual/bootloader = "u-boot-pinenote"
PREFERRED_PROVIDER_virtual/kernel = "linux-pinenote-smaeul"
# TODO: patch the dts into the source tree
#PREFERRED_PROVIDER_virtual/kernel = "linux-pinenote-pine64"

KERNEL_IMAGETYPE ?= "Image"
#KERNEL_DEVICETREE = "rockchip/rk3566-pinenote.dtb"

IMAGE_FSTYPES ?= "tar.bz2"
#IMAGE_FSTYPES ?= "tar.gz"

# Generate debug rootfs along for debugging purposes
IMAGE_GEN_DEBUGFS ?= "1"
IMAGE_FSTYPES_DEBUGFS ?= "tar.bz2"

#IMAGE_BOOT_FILES ?= " \
#    rk3566-pinenote.dtb \
#    "

SERIAL_CONSOLE ?= "1500000;ttyS0"
SERIAL_CONSOLES = "1500000;ttyS0"

MACHINE_FEATURES += " bluetooth screen touchscreen usbgadget usbhost wifi"

MACHINE_FIRMWARE:append = " linux-firmware-bcm43455 linux-firmware-rockchip-ebc"

MACHINE_EXTRA_RRECOMMENDS += " ${MACHINE_FIRMWARE}"

IMAGE_INSTALL:append = " kernel-devicetree kernel-image kernel-modules ${MACHINE_FIRMWARE}"

DISTRO_FEATURES:append = " pam usbgadget usbhost"
#DISTRO_FEATURES:append = " systemd"
#DISTRO_FEATURES_BACKFILL_CONSIDERED += "sysvinit"

#DISTRO_FEATURES:remove = "x11 wayland"
DISTRO_FEATURES:append = " directfb opengl"

INIT_MANAGER = "systemd"

ROOT_HOME = "/root"
```

## conf/machine/radxa-rock5b-pcie-ep.conf
```bitbake
#@TYPE: Machine
#@NAME: Radxa Rock 5B PCIe Endpoint
#@DESCRIPTION: An Rockchip RK3588 PCIe endpoint based development board https://wiki.radxa.com/Rock5/5b

require conf/machine/include/radxa-rock5b.inc

UBOOT_EXTLINUX_FDTOVERLAYS = " ../rk3588-rock-5b-pcie-ep.dtbo"

IMAGE_BOOT_FILES = " \
    Image \
    rk3588-rock-5b.dtb \
    rk3588-rock-5b-pcie-ep.dtbo \
    extlinux.conf;extlinux/extlinux.conf \
    "
```

## conf/machine/radxa-rock5b.conf
```bitbake
#@TYPE: Machine
#@NAME: Radxa Rock 5B
#@DESCRIPTION: An Rockchip RK3588 based development board https://wiki.radxa.com/Rock5/5b

require conf/machine/include/radxa-rock5b.inc

UBOOT_EXTLINUX_FDTOVERLAYS:rk3588 = " ../rk3588-rock-5b-pcie-srns.dtbo"

IMAGE_BOOT_FILES = " \
    Image \
    rk3588-rock-5b.dtb \
    rk3588-rock-5b-pcie-srns.dtbo \
    extlinux.conf;extlinux/extlinux.conf \
    "
```

## conf/machine/sopine-a64.conf
```bitbake
#@TYPE: Machine
#@NAME: SOPINE A64 Baseboard
#@DESCRIPTION: An Allwinner based development board https://www.pine64.org/

require conf/machine/include/arm/arch-arm64.inc
require conf/machine/include/a64.inc

EXTRA_IMAGEDEPENDS += "u-boot"
UBOOT_MACHINE ?= "sopine_baseboard_defconfig"

PREFERRED_PROVIDER_virtual/kernel ?= "linux-pine64"
KERNEL_CLASSES = "kernel-fitimage"
KERNEL_IMAGETYPE = "fitImage"
KERNEL_DEVICETREE = "allwinner/sun50i-a64-sopine-baseboard.dtb"

MACHINE_EXTRA_RRECOMMENDS += "kernel-modules"

IMAGE_FSTYPES += "wic"
WKS_FILE ?= "pine64-bsp-image.wks"

IMAGE_BOOT_FILES ?= " \
    fitImage \
    boot.scr \
    "

WKS_FILE_DEPENDS ?= " \
    mtools-native \
    dosfstools-native \
    virtual/bootloader \
    virtual/kernel \
    "

SERIAL_CONSOLES = "115200;ttyS0"
MACHINE_FEATURES = "alsa apm keyboard rtc serial screen touchscreen usbgadget usbhost vfat ext2 ext3 wifi"
```

## files/wic/pine-pinetab2-bsp-image.wks
```
bootloader --ptable gpt

part loader --align 32 --no-table --source rawcopy --sourceparams="file=u-boot-rockchip.bin"

part /boot --offset 16777216 --ondisk mmcblk1 --fstype=vfat --label boot   --source bootimg-partition --size=1G --active
part /     --align 4096      --ondisk mmcblk1 --fstype=ext4 --label rootfs --source=rootfs --uuid B921B045-1DF0-41C3-AF44-4C6F280D3FAE
```

## wic/pine-rockpro64-bsp-image.wks
```
bootloader --ptable gpt

part loader1 --align 32   --no-table --source rawcopy --sourceparams="file=idbloader.img"
part loader2 --align 8192 --no-table --source rawcopy --sourceparams="file=u-boot.itb"

part /boot --offset 16777216 --ondisk mmcblk1 --fstype=vfat --label boot   --source bootimg-partition --size=100M --active
part /     --align 4096      --ondisk mmcblk1 --fstype=ext4 --label rootfs --source=rootfs --uuid B921B045-1DF0-41C3-AF44-4C6F280D3FAE
```

## wic/pine64-bsp-image.wks
```
#
# The disk layout used is:
#
#    0                   -> reserverd
#    8 KiB               -> u-boot SPL and u-boot
#    20480 KiB           -> kernel, dtbs, boot script
#    20480 KiB + 50 MiB  -> rootfs
#

part spl   --align 8                          --ondisk mmcblk0 --no-table                     --source rawcopy           --sourceparams="file=u-boot-sunxi-with-spl.bin"
part /boot --align 20480 --size=100M --active --ondisk mmcblk0 --fstype=vfat --label pine64   --source bootimg-partition
part /     --align 4096                       --ondisk mmcblk0 --fstype=ext4 --label platform --source=rootfs
```

## wic/radxa-rock5b-bsp-image.wks
```
bootloader --ptable gpt

part loader1 --align 32   --no-table --source rawcopy --sourceparams="file=idbloader.img"
part loader2 --align 8192 --no-table --source rawcopy --sourceparams="file=u-boot.itb"

part trust   --align 4    --no-table --source rawcopy --sourceparams="file=tee-rk3588.bin"

part /boot --fstype=vfat --label boot   --source bootimg-partition --size=100M --active
part / --source rootfs --fstype ext4 --part-name rootfs --uuid 614e0000-0000-4b53-8000-1d28000054a9 --mkfs-extraopts "-F -i 8192 -b 4096" --align 8192
```
